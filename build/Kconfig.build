## build/Kconfig.build
```kconfig
#
# For a description of the syntax of this configuration file,
# see Documentation/kbuild/kconfig-language.txt.
#
mainmenu "VSSDK BUILD Configuration"

menu "Build Configuration"
source "Kconfig.product"
endmenu

menu "Target Options"

choice
	prompt "Target SoC"
	default BERLIN_VS640_A0
source kconfig/Kconfig.chip
endchoice

choice
	prompt "Target OS"
	default ANDROID_OS

source kconfig/Kconfig.os
endchoice

source "module/sysroot/Kconfig.build"
choice
	prompt "Image Type"
	default IMAGE_EMMC
config IMAGE_EMMC
	bool "EMMC image"
config IMAGE_NAND
	bool "NAND image"
config IMAGE_USBBOOT
	bool "USBBOOT image"
endchoice

source "module/image/Kconfig.build"

endmenu

menu "Host Options"

config CPU_NUMBER
	int "CPU for compiling"
	default 18

source kconfig/Kconfig.path
config SYNA_SDK_OUT_SYSYROOT
	string
	default "build_sysroot"
	help
		System root for build.
		Used as ${CONFIG_SYNA_SDK_OUT_TARGET_PATH}/${CONFIG_SYNA_SDK_OUT_SYSYROOT}

config SYNA_SDK_OUT_ROOTFS
	string
	default "system"
	help
		Root FS for image generation
		Used as ${CONFIG_SYNA_SDK_OUT_TARGET_PATH}/${CONFIG_SYNA_SDK_OUT_ROOTFS}


source "module/toolchain/Kconfig.build"
source "kconfig/Kconfig.tool"
endmenu


source "module/linux/Kconfig.build"

menu "Boot"

config PREBOOT_PLATFORM
	string "platform for boot"
	default "bg5ct_stb"
	help
		bg5ct_stb/bg5ct_minibox/bg5ct_sec/bg5ct_pek/bg5ct_ffv/bg5ct_IP1500/bg5ct_ginkgo/bg5ct_mozart

config GENX_ENABLE
	bool "GenX enable"
		default n
		help
			enable GenX secure boot flow

config GEN_SKIP
	bool "Gen skip"
		default n
		help
			skip gen secure image

config FASTBOOT_FLOW
	bool "enable fastboot in bootflow"
	depends on ANDROID_OS
	default y

choice
	prompt "PREBOOT type"
	default PREBOOT
config PREBOOT
	bool "standard preboot"
config EXTERNAL_PREBOOT
	bool "external preboot"
endchoice

source "module/external_preboot/Kconfig.build"
source "module/preboot/Kconfig.build"

choice
        prompt "BOOTLOADER type"
	default BOOTLOADER
config BOOTLOADER
        bool "standard bootloader"
config EXTERNAL_BOOTLOADER
        bool "external bootloader"
endchoice

source "module/external_bootloader/Kconfig.build"
source "module/bootloader/Kconfig.build"

config EXTERNAL_BOOT
        depends on EXTERNAL_BOOTLOADER || EXTERNAL_PREBOOT
        string "external boot path"
        default "google_cast"

source "module/uboot/Kconfig.build"
endmenu

menu "Trusted Environment Options"

source "module/tee/Kconfig.build"
source "module/tee_dev/Kconfig.build"
endmenu

# source "module/drm/Kconfig.build"

source "module/ampsdk/Kconfig.build"
source "module/ta_enc/Kconfig.build"
# source "module/fw_enc/Kconfig.build"
source "module/thirdparty/Kconfig.build"
source "module/synap/Kconfig.build"

menu "Target Packages"
source "module/application/Kconfig.build"
source "module/external/Kconfig.build"
source "module/ta_app/Kconfig.build"
endmenu

source "module/security/Kconfig.build"
source ".Kconfig_external.build"
```

## build/kconfig/Kconfig.chip
```kconfig
config BERLIN_AS470_A0
        bool "BERLIN AS470 A0"

config BERLIN_VS680_Z1
        bool "BERLIN VS680 Z1"

config BERLIN_VS640_A0
        bool "BERLIN VS640 A0"

config BERLIN_VS680_A0
        bool "BERLIN VS680 A0"
```

## build/kconfig/Kconfig.release.chip
```kconfig
config BERLIN_LIST_SOC
	string "Supported SoC"
	default "BG5CT AS370 AS371 AS390 VS680"
```

## build/module/ampsdk/Kconfig.build
```kconfig
#
# For a description of the syntax of this configuration file,
# see Documentation/kbuild/kconfig-language.txt.
#

menuconfig AMPSDK
    bool "AMP Enable"
    default y
    help
        AMP support

if AMPSDK

config PRE_BUILD_AMPSDK
	bool "USE PREBUILD AMP"
	help
		Skip source build, used pre-build binary

source "module/ampsdk/kconfig/Kconfig.system"
source "module/ampsdk/kconfig/Kconfig.drm"
source "module/ampsdk/kconfig/Kconfig.clk"
source "module/ampsdk/kconfig/Kconfig.avin"
source "module/ampsdk/kconfig/Kconfig.dmx"
source "module/ampsdk/kconfig/Kconfig.video"
source "module/ampsdk/kconfig/Kconfig.audio"
source "module/ampsdk/kconfig/Kconfig.isp"
source "module/ampsdk/kconfig/Kconfig.fe"
source "module/ampsdk/kconfig/Kconfig.scrd"
source "module/ampsdk/kconfig/Kconfig.amplitude"

endif
```

## build/module/external_bootloader/Kconfig.build
```kconfig
#

# For a description of the syntax of this configuration file,
# see Documentation/kbuild/kconfig-language.txt.
#
menu "External Bootloader Configuration"
depends on EXTERNAL_BOOTLOADER

config BL_REL_PATH
	string
	default "external_bootloader"
	help
		Used as ${CONFIG_SYNA_SDK_OUT_TARGET_PATH}/${CONFIG_BL_REL_PATH}

menuconfig BL_PRELOAD_TA
	bool "Preload TA"
	default y
	help
		Some TA will be loaded by bootloader in early stage to use TA feature
		before linux file system is ready.

if BL_PRELOAD_TA

config BL_TA_FASTLOGO
	depends on BL_PRELOAD_TA && BL_FASTLOGO
	bool "fastlogo ta"
	default y

config BL_TA_KEYMASTER
	depends on BL_PRELOAD_TA
	bool "keymaster ta"
	default y

config TA_KEYMASTER_V4
	depends on BL_TA_KEYMASTER
	bool "keymaster v4"
	default n

endif

config BL_CPUPLL
	string "CPUPLL (800, 1200, 1500, etc.)"
	default "800"
	help
		dynamicly change the cpu pll in bootloader

config BL_FASTLOGO
	bool "Fastlogo"
	default y
	help
		display fastlogo when system is booting up

config BL_RPMB
        bool "RPMB"
        default y
        help
                Replay Protected Memory Block is for trusted storage

config BL_SYSTEM_AS_ROOT
	depends on ANDROID_OS && PREBOOT_BOOTFLOW_NR
	bool "System as Root"
	default n
	help
		config to enable system as root

config BL_DTB
	bool "DTB Modify"
	default y
	help
		config to enable dtb modification for kernel params

config BL_RECOVERY_DTBO
	depends on ANDROID_OS && PREBOOT_BOOTFLOW_NR
	bool "DTBO for Recovery"
	default n
	help
		config to enable recovery dtbo

config BL_PV_COMP
	bool "PV Compensation"
	default y
	help
		the pv comp is used to control cpu voltage and transfer pv table

endmenu
```

## build/module/synap/Kconfig.build
```kconfig
#
# For a description of the syntax of this configuration file,
# see Documentation/kbuild/kconfig-language.txt.
#
menu "SYNAP Configuration"

source module/synap/Kconfig.common
endmenu
```

## build/module/uboot/Kconfig.build
```kconfig
#
# For a description of the syntax of this configuration file,
# see Documentation/kbuild/kconfig-language.txt.
#
menuconfig UBOOT
	bool "U-boot"
	default y
	select PREBOOT
	select SECURITY

if UBOOT

choice
	prompt "select uboot action"
	default UBOOT_FASTBOOT

	config UBOOT_SPIUBOOT
		bool "uboot for SPI U-boot"
		default n

	config UBOOT_FASTBOOT
		bool "uboot for Fastboot"
		depends on ANDROID_OS
		default y

	config UBOOT_BOOTUP_SYSTEM
		bool "uboot for bootup system"
		default n

endchoice

config UBOOT_SRC_PATH
	string "Uboot code path"
	default "u-boot_2019_10"
	help
		Used as uboot code path


config UBOOT_ARCH
	string "Architechture"
	depends on UBOOT
	default "arm"

config UBOOT_DEFCONFIG
	string "Default Config"
	depends on UBOOT
	default "berlin5ct-fastboot_defconfig"

config UBOOT_DTS
	string "DTS"
	depends on UBOOT
	default "berlin5ct-stb-fastboot"

config UBOOT_REL_PATH
	string
	depends on UBOOT
	default "release/uboot"
	help
		Used as ${CONFIG_SYNA_SDK_OUT_TARGET_PATH}/${CONFIG_UBOOT_REL_PATH}

endif
```
